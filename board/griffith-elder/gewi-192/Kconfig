## board/griffith-elder/gewi-192/Kconfig
```kconfig
if TARGET_GEWI-192

config SYS_BOARD
	default "gewi-192"

config SYS_VENDOR
	default "griffith-elder"

config SYS_CONFIG_NAME
	default "gewi-192"

config IMX_CONFIG
	default "board/griffith-elder/gewi-192/imximage.cfg"

endif
```

## board/griffith-elder/gewi192/Kconfig
```kconfig
if TARGET_GEWI192

config SYS_BOARD
	default "gewi192"

config SYS_VENDOR
	default "griffith-elder"

config SYS_CONFIG_NAME
	default "gewi192"

config IMX_CONFIG
	default "board/griffith-elder/gewi192/imximage.cfg"

endif
```
